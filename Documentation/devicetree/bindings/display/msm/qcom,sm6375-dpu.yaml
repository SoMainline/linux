## Documentation/devicetree/bindings/display/msm/qcom,sm6375-dpu.yaml
```yaml
# SPDX-License-Identifier: GPL-2.0-only or BSD-2-Clause
%YAML 1.2
---
$id: http://devicetree.org/schemas/display/msm/qcom,sm6375-dpu.yaml#
$schema: http://devicetree.org/meta-schemas/core.yaml#

title: Qualcomm Display DPU dt properties for SM6375 target

maintainers:
  - Konrad Dybcio <konrad.dybcio@linaro.org>

$ref: /schemas/display/msm/dpu-common.yaml#

properties:
  compatible:
    items:
      - const: qcom,sm6375-dpu

  reg:
    items:
      - description: Address offset and size for mdp register set
      - description: Address offset and size for vbif register set

  reg-names:
    items:
      - const: mdp
      - const: vbif

  clocks:
    items:
      - description: Display iface clock
      - description: Display bus clock
      - description: Display core clock
      - description: Display lut clock
      - description: Display rot clock
      - description: Display vsync clock
      - description: Display throttle clock

  clock-names:
    items:
      - const: iface
      - const: bus
      - const: core
      - const: lut
      - const: rot
      - const: vsync
      - const: throttle

unevaluatedProperties: false

examples:
  - |
    #include <dt-bindings/clock/qcom,sm6375-gcc.h>
    #include <dt-bindings/clock/qcom,sm6375-dispcc.h>
    #include <dt-bindings/power/qcom-rpmpd.h>

    display-controller@ae01000 {
        compatible = "qcom,sm6375-dpu";
        reg = <0x05e01000 0x8e030>,
              <0x05eb0000 0x2008>;
        reg-names = "mdp", "vbif";

        clocks = <&dispcc DISP_CC_MDSS_AHB_CLK>,
                 <&gcc GCC_DISP_HF_AXI_CLK>,
                 <&dispcc DISP_CC_MDSS_MDP_CLK>,
                 <&dispcc DISP_CC_MDSS_MDP_LUT_CLK>,
                 <&dispcc DISP_CC_MDSS_ROT_CLK>,
                 <&dispcc DISP_CC_MDSS_VSYNC_CLK>,
                 <&gcc GCC_DISP_THROTTLE_CORE_CLK>;
        clock-names = "iface",
                      "bus",
                      "core",
                      "lut",
                      "rot",
                      "vsync",
                      "throttle";

        assigned-clocks = <&dispcc DISP_CC_MDSS_VSYNC_CLK>;
        assigned-clock-rates = <19200000>;

        operating-points-v2 = <&mdp_opp_table>;
        power-domains = <&rpmpd SM6375_VDDCX>;

        interrupt-parent = <&mdss>;
        interrupts = <0>;

        ports {
            #address-cells = <1>;
            #size-cells = <0>;

            port@0 {
                reg = <0>;
                endpoint {
                    remote-endpoint = <&dsi0_in>;
                };
            };

            port@1 {
                reg = <1>;
                endpoint {
                    remote-endpoint = <&dsi1_in>;
                };
            };
        };
    };
...
```

## Documentation/devicetree/bindings/display/panel/lenovo,nt36523w-boe-j606.yaml
```yaml
# SPDX-License-Identifier: GPL-2.0-only or BSD-2-Clause
%YAML 1.2
---
$id: http://devicetree.org/schemas/display/panel/lenovo,nt36523w-boe-j606.yaml#
$schema: http://devicetree.org/meta-schemas/core.yaml#

title: NT36523W BOE panel found on Lenovo J606 devices

maintainers:
  - Konrad Dybcio <konrad.dybcio@linaro.org>

allOf:
  - $ref: panel-common.yaml#

properties:
  compatible:
    const: lenovo,nt36523w-boe-j606

  reg:
    maxItems: 1
    description: DSI virtual channel

  vddio-supply: true
  reset-gpios: true
  rotation: true
  port: true

additionalProperties: false

required:
  - compatible
  - reg
  - vddio-supply
  - reset-gpios
  - port

examples:
  - |
    #include <dt-bindings/gpio/gpio.h>
    dsi {
        #address-cells = <1>;
        #size-cells = <0>;

        panel@0 {
            compatible = "lenovo,nt36523w-boe-j606";
            reg = <0>;

            reset-gpios = <&tlmm 82 GPIO_ACTIVE_LOW>;
            vddio-supply = <&pm6125_l9>;

            rotation = <180>;

            port {
                panel0_in: endpoint {
                    remote-endpoint = <&mdss_dsi0_out>;
                };
            };
        };
    };
...
```

## Documentation/devicetree/bindings/display/panel/samsung,sofef01-m.yaml
```yaml
# SPDX-License-Identifier: (GPL-2.0-only OR BSD-2-Clause)
%YAML 1.2
---
$id: http://devicetree.org/schemas/display/panel/samsung,sofef01-m.yaml#
$schema: http://devicetree.org/meta-schemas/core.yaml#

title: Samsung SOFEF01-M 1080x2520 6.0"/6.1" OLED DSI panels

maintainers:
  - Marijn Suijten <marijn.suijten@somainline.org>

description: |
  Samsung SOFEF01-M Driver-IC panels found in the Sony Xperia 5
  (kumano bahamut) and Sony Xperia 10 II (seine pdx201) smartphones.

allOf:
  - $ref: panel-common.yaml#

  - if:
      properties:
        compatible:
          const: samsung,sofef01-m-amb609tc01
    then:
      properties:
        vci-supply:
          description: DriverIC Operation supply (3.0V)

      required:
        - vci-supply

    else:
      properties:
        vci-supply: false

properties:
  compatible:
    enum:
      - samsung,sofef01-m-amb609tc01 # 6.1"
      - samsung,sofef01-m-ams597ut01 # 6.0"
      - samsung,sofef01-m-ams597ut04 # 6.0"
      - samsung,sofef01-m-ams597ut05 # 6.0"

  port: true

  reg:
    maxItems: 1
    description: DSI virtual channel

  reset-gpios: true

  vddio-supply:
    description: I/O voltage supply (1.8V)

required:
  - compatible
  - port
  - reg
  - reset-gpios
  - vddio-supply

additionalProperties: false

examples:
  - |
    #include <dt-bindings/gpio/gpio.h>

    dsi {
        #address-cells = <1>;
        #size-cells = <0>;
        panel@0 {
            compatible = "samsung,sofef01-m-amb609tc01";
            reg = <0>;

            reset-gpios = <&tlmm 6 GPIO_ACTIVE_LOW>;

            vci-supply = <&vreg_l17a_3p0>;
            vddio-supply = <&vreg_l14a_1p8>;

            port {
                endpoint {
                    remote-endpoint = <&dsi0_out>;
                };
            };
        };
    };

  - |
    #include <dt-bindings/gpio/gpio.h>

    dsi {
        #address-cells = <1>;
        #size-cells = <0>;
        panel@0 {
            compatible = "samsung,sofef01-m-ams597ut01";
            reg = <0>;

            reset-gpios = <&tlmm 90 GPIO_ACTIVE_LOW>;

            vddio-supply = <&pm6125_l12>;

            port {
                endpoint {
                    remote-endpoint = <&dsi0_out>;
                };
            };
        };
    };

---
```

## Documentation/devicetree/bindings/display/panel/samsung,sofef03-m.yaml
```yaml
# SPDX-License-Identifier: (GPL-2.0-only OR BSD-2-Clause)
%YAML 1.2
---
$id: http://devicetree.org/schemas/display/panel/samsung,sofef03-m.yaml#
$schema: http://devicetree.org/meta-schemas/core.yaml#

title: Samsung SOFEF03-M 1080x2520@120Hz 6.1" OLED DSI panels

maintainers:
  - Marijn Suijten <marijn.suijten@somainline.org>

description: |
  Samsung SOFEF03-M Driver-IC panel found in the Sony Xperia 5 II
  (edo pdx206) and Sony Xperia 5 III (sagami pdx214) smartphones.

allOf:
  - $ref: panel-common.yaml#

properties:
  compatible:
    enum:
      - samsung,sofef03-m-amb609vp01

  port: true

  reg:
    maxItems: 1
    description: DSI virtual channel

  reset-gpios: true

  vci-supply:
    description: DriverIC Operation supply (3.0V)

  vddio-supply:
    description: I/O voltage supply (1.8V)

required:
  - compatible
  - port
  - reg
  - reset-gpios
  - vci-supply
  - vddio-supply

additionalProperties: false

examples:
  - |
    #include <dt-bindings/gpio/gpio.h>

    dsi {
        #address-cells = <1>;
        #size-cells = <0>;
        panel@0 {
            compatible = "samsung,sofef03-m-amb609vp01";
            reg = <0>;

            reset-gpios = <&tlmm 75 GPIO_ACTIVE_LOW>;

            vci-supply = <&vreg_l11c_3p0>;
            vddio-supply = <&vreg_l14a_1p8>;

            port {
                endpoint {
                    remote-endpoint = <&dsi0_out>;
                };
            };
        };
    };

...
```

## Documentation/devicetree/bindings/display/panel/sony,akatsuki-lgd.yaml
```yaml
# SPDX-License-Identifier: (GPL-2.0-only OR BSD-2-Clause)
%YAML 1.2
---
$id: http://devicetree.org/schemas/display/panel/sony,akatsuki-lgd.yaml#
$schema: http://devicetree.org/meta-schemas/core.yaml#

title: Sony Xperia XZ3 LG Display 1440x2880 6.0" OLED DSI panel

maintainers:
  - Marijn Suijten <marijn.suijten@somainline.org>

description: |
  This is an unnamed 6.0" 1440x2880 (9:18 aspect ratio) 60 hz panel
  produced by LG Display, found in the Sony Xperia XZ3 smartphone.
  It is always programmed with DSI 1.1. enabled.

  The assembly features an Atmel maXTouch digitizer, described separately
  as atmel,maxtouch.

allOf:
  - $ref: panel-common.yaml#

properties:
  compatible:
    const: sony,akatsuki-lgd

  port: true

  reg:
    maxItems: 1
    description: DSI virtual channel

  reset-gpios: true

  vddio-supply:
    description: I/O voltage supply (1.8V)

required:
  - compatible
  - port
  - reg
  - reset-gpios
  - vddio-supply

additionalProperties: false

examples:
  - |
    #include <dt-bindings/gpio/gpio.h>

    dsi {
        #address-cells = <1>;
        #size-cells = <0>;
        panel@0 {
            compatible = "sony,akatsuki-lgd";
            reg = <0>;

            vddio-supply = <&vreg_l14a_1p8>;

            reset-gpios = <&tlmm 6 GPIO_ACTIVE_HIGH>;

            port {
                panel_in: endpoint {
                    remote-endpoint = <&dsi0_out>;
                };
            };
        };
    };

...
```

## Documentation/devicetree/bindings/display/panel/sony,discovery-td4322-innolux.yaml
```yaml
# SPDX-License-Identifier: (GPL-2.0-only OR BSD-2-Clause)
%YAML 1.2
---
$id: http://devicetree.org/schemas/display/panel/sony,discovery-td4322-innolux.yaml#
$schema: http://devicetree.org/meta-schemas/core.yaml#

title: SONY Discovery TD4322 Innolux 6.0" 1080×1920 LCD Panel

maintainers:
  - Konrad Dybcio <konrad.dybcio@somainline.org>

description: |+
  This panel seems to only be found in the Sony Xperia XA2 Ultra
  smartphone and we have no straightforward way of
  actually getting the correct model number,
  as no schematics are released publicly.

allOf:
  - $ref: panel-common.yaml#

properties:
  compatible:
    const: sony,discovery-td4322-innolux
  reg: true
  reset-gpios: true
  vdd-supply:
    description: core voltage supply
  vddio-supply:
    description: vddio supply
  vsp-supply:
    description: positive voltage supply
  vsn-supply:
    description: negative voltage supply

required:
  - compatible
  - reg
  - vdd-supply
  - vddio-supply
  - vsp-supply
  - vsn-supply
  - reset-gpios

additionalProperties: false

examples:
  - |
    #include <dt-bindings/gpio/gpio.h>

    dsi {
            #address-cells = <1>;
            #size-cells = <0>;
            panel@0 {
                    reg = <0>;
                    compatible = "sony,discovery-td4322-innolux";

                    vdd-supply = <&pm8916_l8>;
                    vddio-supply = <&pm8916_l6>;
                    vsp-supply = <&lab>;
                    vsn-supply = <&ibb>;
                    reset-gpios = <&tlmm 53 GPIO_ACTIVE_HIGH>;
            };
    };
```

## Documentation/devicetree/bindings/display/panel/sony,griffin-samsung.yaml
```yaml
# SPDX-License-Identifier: (GPL-2.0-only OR BSD-2-Clause)
%YAML 1.2
---
$id: http://devicetree.org/schemas/display/panel/sony,griffin-samsung-4k-oled.yaml#
$schema: http://devicetree.org/meta-schemas/core.yaml#

title: Sony Xperia 1 Samsung 1644x3840 6.5" OLED DSI panel

maintainers:
  - Marijn Suijten <marijn.suijten@somainline.org>

description: |
  Unnamed Samsung Driver-IC and panel found in the Sony Xperia 1
  (kumano griffin) smartphone.

allOf:
  - $ref: panel-common.yaml#

properties:
  compatible:
    enum:
      - sony,griffin-samsung-4k-oled

  port: true

  reg:
    maxItems: 1
    description: DSI virtual channel

  reset-gpios: true

  vci-supply:
    description: DriverIC Operation supply (3.0V)

  vddio-supply:
    description: I/O voltage supply (1.8V)

required:
  - compatible
  - port
  - reg
  - reset-gpios
  - vci-supply
  - vddio-supply

additionalProperties: false

examples:
  - |
    #include <dt-bindings/gpio/gpio.h>

    dsi {
        #address-cells = <1>;
        #size-cells = <0>;
        panel@0 {
            compatible = "sony,griffin-samsung-4k-oled";
            reg = <0>;

            reset-gpios = <&tlmm 6 GPIO_ACTIVE_LOW>;

            vci-supply = <&vreg_l17a_3p0>;
            vddio-supply = <&vreg_l14a_1p8>;

            port {
                endpoint {
                    remote-endpoint = <&dsi0_out>;
                };
            };
        };
    };

...
```
